## src/conf/bblayers.conf
```bitbake
# POKY_BBLAYERS_CONF_VERSION is increased each time build/conf/bblayers.conf
# changes incompatibly
POKY_BBLAYERS_CONF_VERSION = "2"

BBPATH = "${TOPDIR}"
BBFILES ?= ""

BBLAYERS ?= " \
  /home/jpv/yocto/poky/meta \
  /home/jpv/yocto/poky/meta-poky \
  /home/jpv/yocto/poky/meta-yocto-bsp \
  /home/jpv/yocto/poky/meta-raspberrypi \
  /home/jpv/yocto/poky/meta-openembedded/meta-oe \
  /home/jpv/yocto/poky/meta-openembedded/meta-python \
  /home/jpv/yocto/poky/meta-openembedded/meta-networking \
  /home/jpv/yocto/poky/meta-tensorflow-lite \
  /home/jpv/yocto/poky/meta-archivos \
  "
```

## src/meta-archivos/conf/layer.conf
```bitbake
# We have a conf and classes directory, add to BBPATH
BBPATH .= ":${LAYERDIR}"

# We have recipes-* directories, add to BBFILES
BBFILES += "${LAYERDIR}/recipes-*/*/*.bb \
            ${LAYERDIR}/recipes-*/*/*.bbappend"

BBFILE_COLLECTIONS += "meta-archivos"
BBFILE_PATTERN_meta-archivos = "^${LAYERDIR}/"
BBFILE_PRIORITY_meta-archivos = "6"

LAYERDEPENDS_meta-archivos = "core"
LAYERSERIES_COMPAT_meta-archivos = "dunfell"
```
